## net/nginx-fillo/Config.in
```kconfig
#
# Copyright (C) 2010-2012 OpenWrt.org
#
# This is free software, licensed under the GNU General Public License v2.
# See /LICENSE for more information.
#

menu "Configuration"
        depends on PACKAGE_nginx-fillo

config NGINX_FILLO_ECHO
	bool
	prompt "Enable ECHO module"
	help
		Brings "echo", "sleep", "time", "exec" and more shell-style goodies to Nginx config file.

		More: https://github.com/openresty/echo-nginx-module
	default y

config NGINX_FILLO_HTTP2
	bool
	prompt "Enable HTTP/2 module"
	help
		The ngx_http_v2_module module (1.9.5) provides support for HTTP/2 and supersedes the ngx_http_spdy_module module.

		More: https://nginx.org/en/docs/http/ngx_http_v2_module.html
	default y

config NGINX_FILLO_SSL
	bool
	prompt "Enable SSL module"
	help
		Enable HTTPS/SSL support.
	default y

config NGINX_FILLO_DAV
	bool
	prompt "Enable WebDAV module"
	help
		Enable the HTTP and WebDAV methods PUT, DELETE, MKCOL, COPY and MOVE.
	default n

config NGINX_FILLO_FLV
	bool
	prompt "Enable FLV module"
	help
		Provides the ability to seek within FLV (Flash) files using time-based offsets.
	default n

config NGINX_FILLO_STUB_STATUS
	bool
	prompt "Enable stub status module"
	help
		Enable the stub status module which gives some status from the server.
	default y

config NGINX_FILLO_SUBSTITUTIONS_FILTER
	bool
	prompt "Enable substitutions module"
	help
		Filter module which can do both regular expression and fixed string substitutions on response bodies.

		More info: https://www.nginx.com/resources/wiki/modules/substitutions/
	default y

config NGINX_FILLO_HTTP_SUB
	bool
	prompt "Enable HTTP sub module"
	help
		The ngx_http_sub_module module is a filter that modifies a response by replacing one specified string by another.
	default y

config NGINX_FILLO_HTTP_CHARSET
	bool
	prompt "Enable HTTP charset module"
	default y

config NGINX_FILLO_HTTP_GZIP
	bool
	prompt "Enable HTTP gzip module"
	default y

config NGINX_FILLO_HTTP_SSI
	bool
	prompt "Enable HTTP ssi module"
	default y

config NGINX_FILLO_HTTP_USERID
	bool
	prompt "Enable HTTP userid module"
	default y

config NGINX_FILLO_HTTP_ACCESS
	bool
	prompt "Enable HTTP access module"
	default y

config NGINX_FILLO_HTTP_AUTH_BASIC
	bool
	prompt "Enable HTTP auth basic"
	default y

config NGINX_FILLO_HTTP_AUTOINDEX
	bool
	prompt "Enable HTTP autoindex module"
	default y

config NGINX_FILLO_HTTP_GEO
	bool
	prompt "Enable HTTP geo module"
	default y

config NGINX_FILLO_HTTP_MAP
	bool
	prompt "Enable HTTP map module"
	default y

config NGINX_FILLO_HTTP_SPLIT_CLIENTS
	bool
	prompt "Enable HTTP split clients"
	default y

config NGINX_FILLO_HTTP_REFERER
	bool
	prompt "Enable HTTP referer module"
	default y

config NGINX_FILLO_HTTP_REWRITE
	bool
	prompt "Enable HTTP rewrite module"
	select NGINX_FILLO_PCRE
	default y

config NGINX_FILLO_HTTP_PROXY
	bool
	prompt "Enable HTTP proxy module"
	default y

config NGINX_FILLO_HTTP_FASTCGI
	bool
	prompt "Enable HTTP fastcgi module"
	default y

config NGINX_FILLO_HTTP_UWSGI
	bool
	prompt "Enable HTTP uwsgi module"
	default y

config NGINX_FILLO_HTTP_SCGI
	bool
	prompt "Enable HTTP scgi module"
	default y

config NGINX_FILLO_HTTP_MEMCACHED
	bool
	prompt "Enable HTTP memcached module"
	default y

config NGINX_FILLO_HTTP_LIMIT_CONN
	bool
	prompt "Enable HTTP limit conn"
	default y

config NGINX_FILLO_HTTP_LIMIT_REQ
	bool
	prompt "Enable HTTP limit req"
	default y

config NGINX_FILLO_HTTP_EMPTY_GIF
	bool
	prompt "Enable HTTP empty gif"
	default y

config NGINX_FILLO_HTTP_BROWSER
	bool
	prompt "Enable HTTP browser module"
	default y

config NGINX_FILLO_HTTP_UPSTREAM_HASH
	bool
	prompt "Enable HTTP hash module"
	default y

config NGINX_FILLO_HTTP_UPSTREAM_IP_HASH
	bool
	prompt "Enable HTTP IP hash module"
	default y

config NGINX_FILLO_HTTP_UPSTREAM_LEAST_CONN
	bool
	prompt "Enable HTTP least conn module"
	default y

config NGINX_FILLO_HTTP_UPSTREAM_KEEPALIVE
	bool
	prompt "Enable HTTP keepalive module"
	default y

config NGINX_FILLO_HTTP_CACHE
	bool
	prompt "Enable HTTP cache"
	default y

config NGINX_FILLO_PCRE
	bool
	prompt "Enable PCRE library usage"
	default y

endmenu
```
